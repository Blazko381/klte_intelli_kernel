## arch/arm/hotplug/Kconfig
```kconfig
config INTELLI_PLUG
        bool "Enable intelli-plug cpu hotplug driver"
        default n
        help
          Generic Intelli-plug cpu hotplug driver for ARM SOCs

config MAKO_HOTPLUG
	bool "Mako Hotplug"
	default y
	help
	  Mako Hotplug: A custom hotplug by fransisco franco

config BLU_PLUG
	bool "Dynamic hotplug driver"
	depends on HOTPLUG_CPU
	default y
	help
	  The Dynamic hotplug driver automatically online/offline CPUs proportional to system load.
```
